## app/boards/l5_task1/Kconfig
```kconfig
# Copyright 2024-2025 NXP
# SPDX-License-Identifier: Apache-2.0

config BOARD_L5_TASK1
	select BOARD_EARLY_INIT_HOOK
```

## app/boards/l5_task1/Kconfig.l5_task1
```kconfig
# Copyright 2024 NXP
# SPDX-License-Identifier: Apache-2.0

config BOARD_L5_TASK1
	select SOC_MCXA156 if BOARD_L5_TASK1
	select SOC_PART_NUMBER_MCXA156VLL
```

## app/boards/l5_task1/board.yml
```yaml
board:
  name: l5_task1
  full_name: L5 Task 1 Custom Board
  vendor: nxp
  socs:
  - name: mcxa156
```

## app/boards/l5_task2/Kconfig
```kconfig
# Copyright 2024-2025 NXP
# SPDX-License-Identifier: Apache-2.0

config BOARD_L5_TASK2
	select BOARD_EARLY_INIT_HOOK
```

## app/boards/l5_task2/Kconfig.l5_task2
```kconfig
# Custom Kconfig

config BOARD_L5_TASK2
	select SOC_MCXA156 if BOARD_L5_TASK2
	select SOC_PART_NUMBER_MCXA156VLL
```

## app/boards/l5_task2/board.yml
```yaml
board:
  name: l5_task2
  full_name: Board From Scrath for l5-task2
  vendor: iomico
  socs:
  - name: mcxa156
```

## app/boards/my_board/board.yml
```yaml
board:
  name: my_board
  full_name: My Board From Scratch
  vendor: iomico
  socs:
  - name: mcxa156
```

## app/boards/our_board/Kconfig
```kconfig
# Copyright 2024-2025 NXP
# SPDX-License-Identifier: Apache-2.0

config BOARD_OUR_BOARD
	select BOARD_EARLY_INIT_HOOK
```

## app/boards/our_board/Kconfig.our_board
```kconfig
# Copyright 2024 NXP
# SPDX-License-Identifier: Apache-2.0

config BOARD_OUR_BOARD
	select SOC_MCXA156 if BOARD_OUR_BOARD
	select SOC_PART_NUMBER_MCXA156VLL
```

## app/boards/our_board/board.yml
```yaml
board:
  name: our_board
  full_name: Our Board
  vendor: iomico
  socs:
  - name: mcxa156
```

## app/drivers/our_driver/Kconfig
```kconfig
config OUR_DRIVER # Autoenables the driver when DT node is present.
    bool "Our LED sensor driver"
    default y
    depends on DT_HAS_OUR_DRIVER_ENABLED
    depends on SENSOR && GPIO
```
